## examples/protocols/http_server/compass-i2c-reader/sdkconfig.defaults
```kconfig
CONFIG_LWIP_NETIF_LOOPBACK=y
CONFIG_LWIP_LOOPBACK_MAX_PBUFS=1

CONFIG_PARTITION_TABLE_CUSTOM=y
CONFIG_PARTITION_TABLE_CUSTOM_FILENAME="partitions_spiffs.csv"
CONFIG_PARTITION_TABLE_FILENAME="partitions_spiffs.csv"
```
